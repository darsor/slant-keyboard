## zmk/config/boards/shields/slant/Kconfig.defconfig
```kconfig
if SHIELD_SLANT_LEFT

config ZMK_KEYBOARD_NAME
    default "Slant Left"

config ZMK_SPLIT_ROLE_CENTRAL
    default y

config ZMK_SPLIT
    default y

endif

if SHIELD_SLANT_RIGHT

config ZMK_KEYBOARD_NAME
    default "Slant Right"

config ZMK_SPLIT_ROLE_CENTRAL
    default n

config ZMK_SPLIT
    default y

endif
```

## zmk/config/boards/shields/slant/Kconfig.shield
```kconfig
config SHIELD_SLANT_LEFT
    def_bool $(shields_list_contains,slant_left)

config SHIELD_SLANT_RIGHT
    def_bool $(shields_list_contains,slant_right)
```
